#include <Servo.h>
#include <Adafruit_GFX.h>
#include <Adafruit_PCD8544.h>
Adafruit_PCD8544 display= Adafruit_PCD8544(8,9,10,12,11);
#define number_of_74hc595s 3
#define numOfRegisterPins number_of_74hc595s*8
boolean registers[numOfRegisterPins];
int SER_Pin=A1;
int RCLK_Pin=6;
int SRCLK_Pin = 5;
char password[6]={'\0','\0','\0','\0','\0','\0'};
int i=0;
int count=0;
int check=0;
int times=0;
char rpassword[6]={'1','2','3','4','5','6'};
Servo servo_Motor; 
const byte thief[] PROGMEM = {88,48,
B00000000,B00000000,B00000000,B00000000,B00000000,B00000000,B00000000,B00000000,B00000000,B00000000,B00000000,
B00000000,B00000000,B00000000,B00000000,B00000000,B00000000,B00000000,B00000000,B00000000,B00000000,B00000000,
B00000000,B00000000,B00000000,B00000000,B00000000,B00000000,B00000000,B00000000,B00000000,B00000000,B00000000,
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B00000000,B00000000,B00000000,B00000000,B00000000,B00000000,B00000000,B00000000,B00000000,B00000000,B00000000,
};
const byte face[] PROGMEM = {88,48,
B00000000,B00000000,B00000000,B00000000,B00000000,B00000000,B00000000,B00000000,B00000000,B00000000,B00000000,
B00000000,B00000000,B00000000,B00001111,B11111111,B11000000,B00000000,B00000000,B00000000,B00000000,B00000000,
B00000000,B00000000,B00000001,B11100000,B00000000,B00111110,B00000000,B00000000,B00000000,B00000000,B00000000,
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B00000000,B00000000,B00000000,B00000000,B11111000,B00000000,B00000000,B00000000,B00000000,B00000000,B00000000,
};
const byte logo_el[] PROGMEM = {16,10,
B00000000,B00000000,
B11111010,B00000000,
B11111010,B00000000,
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B00000000,B00000000,
};
//*****************************void setup*********************************//
void setup() {
  servo_Motor.attach(A4); 
  Serial.begin(9600);
  pinMode(SER_Pin,OUTPUT);
  pinMode(RCLK_Pin,OUTPUT);
  pinMode(SRCLK_Pin,OUTPUT);
  pinMode(2,OUTPUT);
  servo_Motor.write(90);
  clearRegisters();
  writeRegisters();
  display.begin();
  display.setContrast(50);
  display.clearDisplay();
  display_El_logo();
  display_L2S();
  display_title();
  display.drawBitmap(70,35,logo_el,10,10,BLACK);
}
//*****************************void loop******************************//
void loop() 
   display.drawRect(0, 0, 84 , 48,BLACK);
   display.setCursor(4,8);
   display.println(" ENTER THE ");
   display.setCursor(4,18);
   display.println(" PASSWORD ");
   display.setTextSize(1);
   display.setTextColor(BLACK);
   display.display(); 
 while(Serial.available())
 {   
    password[i]=Serial.read();
    if(i==0)
    {
        display.setCursor(10,30);
        display.print("*");
        display.display(); 
    }
    if(i==1)
    {
        display.setCursor(20,30);
        display.print("*");
        display.display(); 
    }
    if(i==2)
    {
        display.setCursor(30,30);
        display.print("*");
        display.display(); 
    }
    if(i==3)
    {
        display.setCursor(40,30);
        display.print("*");
        display.display(); 
    }
    if(i==4)
    {
        display.setCursor(50,30);
        display.print("*");
        display.display(); 
    }
    if(i==5)
    {
        display.setCursor(60,30);
        display.print("*");
        display.display(); 
    }
     i++;
     if(i==6)
     {
      check=1;
     }
  
 }
 for(int j=0;j<7;j++)
 {
  if(rpassword[j]==password[j])
  {
    count++;    
  }
 }
 if(check==1)
 {
 if(count>=6)
 {  display.clearDisplay();
    display.drawRect(0, 0, 84 , 48,BLACK);
    digitalWrite(2,LOW);
    display.drawBitmap(-7,0,face,84,48,BLACK);
    display.setCursor(12,22);
    display.println(" WELCOME");
    display.display();
    display.clearDisplay();
    servo_Motor.write(180);
    delay(10000);
    servo_Motor.write(90);
    count=0;
    i=0;
    check=0;
 }
 else
 {
    display.clearDisplay();
    display.drawRect(0, 0, 84 , 48,BLACK);
    display.drawBitmap(4,0,thief,84,48,BLACK);
    display.setCursor(1,20);
    display.println("INTRUDER");
    display.display();
    while(times<10)
 {
    digitalWrite(2,HIGH);
    delay(300);
    digitalWrite(2,LOW);
    delay(300);
    times++;
 }
    display.clearDisplay();
    count=0;
    i=0;
    check=0;
    times=0;
 }
 }
 count=0;
}

//****************************Elintlabz logo**************************//
void display_El_logo()
{
   display.fillRect(15,2,21,6,BLACK);
   display.fillRect(15,12,21,6,BLACK);
   display.fillRect(15,22,21,6,BLACK);
   display.fillRect(45,2,6,26,BLACK);
   display.fillRect(50,22,18,6,BLACK);
   display.setCursor(15,35);
   display.print("ElintLabz");
   display.display();
   delay(5000);
   display.clearDisplay();
}

//**************************learn2solder***********************************//
void display_L2S()
{
  display.drawRect(0, 0, 84 , 48,BLACK);
  display.setCursor(26, 10);
  display.println("LEARN");
  display.setCursor(38,20);
  display.println("2");
  display.setCursor(22,30);
  display.println("SOLDER");
  display.display(); 
  delay(5000);
  display.clearDisplay();
}
//***************************clearing registers****************************//
 void clearRegisters(){
  for(int i = numOfRegisterPins - 1; i >=  0; i--){
     registers[i] = LOW;
  }
  writeRegisters();
} 
//*************************writting registers*********************************// 
void writeRegisters(){

  digitalWrite(RCLK_Pin, LOW);

  for(int i = numOfRegisterPins - 1; i >=  0; i--){
    digitalWrite(SRCLK_Pin, LOW);

    int val = registers[i];

    digitalWrite(SER_Pin, val);
    digitalWrite(SRCLK_Pin, HIGH);

  }
  digitalWrite(RCLK_Pin, HIGH);

}
//******************To Display Tittle**************//
void display_title()
{
  display.drawRect(0, 0, 84 , 48,BLACK);
  display.setCursor(16,12);
  display.println("SECURED");
  display.setCursor(13,22);
  display.println("LOCKING");
  display.setCursor(20,32);
  display.println("SYSTEM");
  display.drawBitmap(70,35,logo_el,10,10,BLACK);
  display.display(); 
  delay(5000);
  display.clearDisplay();
}
