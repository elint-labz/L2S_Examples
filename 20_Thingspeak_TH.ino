#include <dht.h>
dht DHT;
#define DHT11_PIN A5

#include <Adafruit_GFX.h>
#include <Adafruit_PCD8544.h>
Adafruit_PCD8544 display = Adafruit_PCD8544(8, 9, 10, 12, 11);

#define SSID "EL Net 2"  //enter your wifi password
#define PASS "EL456login$" //enter your password
#define IP "184.106.153.149"   // ThingSpeak IP Address: 184.106.153.149
#define number_of_74hc595s 3 
#define numOfRegisterPins number_of_74hc595s*8
boolean registers[numOfRegisterPins];
int SER_Pin=A1;
int RCLK_Pin=6;
int SRCLK_Pin = 5;

// GET /update?key=[THINGSPEAK_KEY]&field1=[data 1]&field2=[data 2]...;
String GET = "GET /update?key=U07FH1W3XOE6U46B";
String Temperature,Humidity;
uint32_t timer=0;
const byte tick[] PROGMEM = {88,48,
B00000000,B00000000,B00000000,B00000000,B00000000,B00000000,B00000000,B00000000,B00000000,B00000000,B00000000,
B00000000,B00000000,B00000000,B00000000,B00000000,B00000000,B00000000,B00000000,B00000000,B00000000,B00000000,
B00000000,B00000000,B00000000,B00000000,B00000000,B00000000,B00000000,B00000000,B00000000,B00000000,B00000000,
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B00000000,B00000000,B00000000,B00000000,B00000000,B00000000,B00000000,B00000000,B00000000,B00000000,B00000000,
};
const byte error[] PROGMEM = {88,48,
B00000000,B00000000,B00000000,B00000000,B00000000,B00000000,B00000000,B00000000,B00000000,B00000000,B00000000,
B00000000,B00000000,B00000000,B00000000,B00000000,B00000000,B00000000,B00000000,B00000000,B00000000,B00000000,
B00000000,B00000000,B00000000,B00000000,B00000000,B00000000,B00000000,B00000000,B00000000,B00000000,B00000000,
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B00000000,B00000000,B00000000,B00000000,B00000000,B00000000,B00000000,B00000000,B00000000,B00000000,B00000000,
};
const byte wifi5[] PROGMEM = {88,48,
B00000000,B00000000,B00000000,B11111100,B00000000,B00000000,B00000000,B00000000,B00000000,B00000000,B00000000,
B00000000,B00000000,B00000000,B11111111,B11100000,B00000000,B00000000,B00000000,B00000000,B00000000,B00000000,
B00000000,B00000000,B00000000,B11111111,B11111100,B00000000,B00000000,B00000000,B00000000,B00000000,B00000000,
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B00000000,B00000000,B00000001,B11110000,B00000000,B00000000,B00000000,B00000000,B00000000,B00000000,B00000000,
};


const byte logo_el[] PROGMEM = {16,10,
B00000000,B00000000,
B11111011,B00000000,
B11111011,B00000000,
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B00000000,B00000000,
};

void setup() 
{
  pinMode(SER_Pin,OUTPUT);
  pinMode(RCLK_Pin,OUTPUT);
  pinMode(SRCLK_Pin,OUTPUT);
  clearRegisters();
  writeRegisters();
  Serial.begin(115200);
  display.begin();
  display.setContrast(50);
  display.clearDisplay();
  display_El_logo();
  display_L2S();
  display_title();
  display.display();
  delay(2000);
 
  back: 
  SerialBufferClear();
  timer = (millis()/1000);
  if(!Check_ESP8266())
  {
    delay(500);
    goto back;
  }

  display.clearDisplay();
  display.setCursor(0,33);
  display.print("Conne");
  display.setCursor(0,40);
  display.print("cting");
  
  display.display();
  connectWiFi();
}

void loop() 
{
  int chk = DHT.read11(DHT11_PIN);
  switch (chk)
  {
    case DHTLIB_OK:  
    Temperature = String(DHT.temperature);
    Humidity = String(DHT.humidity);
    updateTS(Temperature,Humidity);
    dis_temp();
    break;
    case DHTLIB_ERROR_CHECKSUM: dis_checksum();
                                 break;
    case DHTLIB_ERROR_TIMEOUT:  dis_timeout();
                                 break;
    default: 
      display.clearDisplay(); 
      display.setCursor(20,25);
      display.print("DHT ERROR");
      draw_error();
      display.display();
      break;
  }
  delay(2000);
}

//**************send data*********************//
void updateTS( String T,String H)
{
  SerialBufferClear();
  String cmd = "AT+CIPSTART=\"TCP\",\"";
  cmd += IP;
  cmd += "\",80";
  Serial.println(cmd);
  timer = (millis()/1000);
  while( (!Serial.available()) && (((millis()/1000)-timer) < 5));
  delay(100);
  if( Serial.find("ERROR") )
  {
    digitalWrite(2,HIGH);
    delay(50);
    digitalWrite(2,LOW);
    return;
  }
    digitalWrite(2,HIGH);
    delay(300);
    digitalWrite(2,LOW);
  SerialBufferClear();  
  cmd = GET + "&field1=" + T +"&field2="+ H  +"\r\n";
  Serial.print( "AT+CIPSEND=" );
  Serial.println( cmd.length() );
  timer = (millis()/1000);
  while( (!Serial.available()) && (((millis()/1000)-timer) < 5));
  if(Serial.find( ">" ) )
  {
    Serial.print(cmd);
  }
  else
  {
      Serial.println( "AT+CIPCLOSE" ); 
      display.clearDisplay();
      display.drawRect(0, 0, 84 , 48,BLACK);
      display.setCursor(5,30);
      display.print("Data Not Sent");
      draw_error();
      display.display();
      delay(1000);
      return;
  }
  
  if( Serial.find("OK") )
  {
      display.clearDisplay();
      display.drawRect(0, 0, 84 , 48,BLACK);
      display.setCursor(5,30);
      draw_tick();
      display.print(" Data sent!");
      display.display();
      delay(1000);
      digitalWrite(2,HIGH);
      delay(300);
      digitalWrite(2,LOW);
  }
  else
  {
      display.clearDisplay();
      display.drawRect(0, 0, 84 , 48,BLACK);
      display.setCursor(0,25);
      display.print("Data Not Sent");
      draw_error();
      display.display();
      delay(1000);
      digitalWrite(2,HIGH);
      delay(50);
      digitalWrite(2,LOW);
  }
  return;
}

//********************connect wifi******************************//


boolean connectWiFi()
{
  draw_wificonnecting();
  SerialBufferClear();
  Serial.println("AT+CWMODE=1");
  delay(200);
  while( ((millis()/1000) - timer) < 5)
  {
    if(Serial.find("OK"))
    {
      goto NEXT1; 
    }
  }

  display.clearDisplay();
  display.drawRect(0, 0, 84 , 48,BLACK);
      display.setCursor(20,30);
      display.print("ERROR!");
      draw_error();
      display.display();
      delay(1000);
      return false;

 NEXT1:

  SerialBufferClear();
  String cmd="AT+CWJAP=\""; // Join accespoint
  cmd+=SSID;
  cmd+="\",\"";
  cmd+=PASS;
  cmd+="\"";
  Serial.println(cmd);
  delay(200);
  while( ((millis()/1000) - timer) < 10)
  {
    if(Serial.find("OK"))
    {
      display.clearDisplay();
      display.setCursor(0,20);
      display.print("Conne");
      display.setCursor(0,30);
      display.print("cted!");
      draw_wificonnected();
      display.display();
      delay(1000);
      return true;
    }
  }

      display.clearDisplay();
       display.drawRect(0, 0, 84 , 48,BLACK);
      display.setCursor(20,30);
      display.print("ERROR!");
      draw_error();
      display.display();
      delay(1000);
      return false;

}

//***************************check ESP8266******************//

boolean Check_ESP8266()
{
  Serial.println("ATE0");
  delay(500);
  while(!Serial.available());
  SerialBufferClear();
  display.clearDisplay();
   display.drawRect(0, 0, 84 , 48,BLACK);
  display.setCursor(0,15);
  display.print(" Checking WiFi Module!");
  display.display();
  delay(1000);
  Serial.println("AT");
  while( ((millis()/1000) - timer) < 5)
  {
    if(Serial.find("OK"))
    {
      display.clearDisplay();
       display.drawRect(0, 0, 84 , 48,BLACK);
      display.setCursor(0,28);
      display.print("  ESP8266 is");
      display.setCursor(20,35);
       display.print("OK");
      draw_tick();
      display.display();
      delay(2000);
      return true; 
    }
  }
  display.clearDisplay();
  display.drawRect(0, 0, 84 , 48,BLACK);
  display.setCursor(0,25);
  display.print("  ESP8266 is    NOT OK");
   draw_error();
  display.display();
  delay(2000);
  return false;
}

//*************clear serial buffer***************************//

void SerialBufferClear()
{
  while(Serial.available())
  {
    char Junk = Serial.read();
  }
}

//*************to draw wifi connected symbol****************//
void draw_wificonnected()
{
  
  display.drawBitmap(0,0,wifi5,84,48,BLACK);
  display.display();
}
//*******************draw wifi connecting**************************//

void draw_wificonnecting()
{
  
  display.drawBitmap(0,0,wifi5,84,48,BLACK);
  display.display();
}
//****************************error symbol*****************************************//
void draw_error()
{
  display.drawBitmap(0,-6,error,84,48,BLACK);
}
//****************************tick mark symbol*****************************************//
void draw_tick()
{
   display.drawBitmap(-15,0,tick,84,48,BLACK);
}

//****************************Elintlabz logo************************************//
void display_El_logo()
{
   display.fillRect(15,2,21,6,BLACK);
   display.fillRect(15,12,21,6,BLACK);
   display.fillRect(15,22,21,6,BLACK);
   display.fillRect(45,2,6,26,BLACK);
   display.fillRect(50,22,18,6,BLACK);
   display.setCursor(15,35);
   display.print("ElintLabz");
   display.display();
   delay(5000);
   display.clearDisplay();
}

//*****************************learn2solder*********************************//
void display_L2S()
{
  display.drawRect(0, 0, 84 , 48,BLACK);
  display.setCursor(26, 10);
  display.println("LEARN");
  display.setCursor(38,20);
  display.println("2");
  display.setCursor(22,30);
  display.println("SOLDER");
  display.display(); 
  delay(5000);
  display.clearDisplay();
}
//************************clearing registers****************************//
void clearRegisters()
{
  for(int i = numOfRegisterPins - 1; i >=  0; i--)
  {
     registers[i] = LOW;
   }
  writeRegisters();
} 
//**************************writting registers******************************//
void writeRegisters()
{
   digitalWrite(RCLK_Pin, LOW);
   for(int i = numOfRegisterPins - 1; i >=  0; i--)
   {
    digitalWrite(SRCLK_Pin, LOW);
    int val = registers[i];
    digitalWrite(SER_Pin, val);
    digitalWrite(SRCLK_Pin, HIGH);
   }
    digitalWrite(RCLK_Pin, HIGH);
}
//**************************display temp and humidity***************************//
void dis_temp()
{ // READ DATA
    display.clearDisplay();
  int chk = DHT.read11(DHT11_PIN);    
  display.drawRect(0, 0, 84 , 48,BLACK);
  display.setCursor(10,2);
  display.print("Temperature:");
  display.setTextSize(1);
  display.setTextColor(BLACK);
  display.setCursor(24,11);
  display.print(DHT.temperature);
  display.setTextSize(1);
  display.setTextColor( BLACK);
  display.drawPixel(56,11,BLACK);                     //** to display ° on the lcd//
  display.drawPixel(55,12,BLACK);
  display.drawPixel(56,13,BLACK);
  display.drawPixel(57,12,BLACK);                                                    
  display.setCursor(59,11);
  display.println("C");
  
  display.setCursor(19,22);
  display.println("Humidity:");
  display.setCursor(19,31);
  display.println(DHT.humidity);
  display.setCursor(53,31);
  display.print("%RH");
  display.drawBitmap(70,37,logo_el,10,10,BLACK);
  display.display();
  display.clearDisplay();
}
//****************************display errors***********************//
void dis_checksum()
{
  display.clearDisplay();
  display.drawRect(0, 0, 84 , 48,BLACK);
  display.setCursor(5,30);
  display.print("DHT error:");
  draw_error();
  display.display();
}

void dis_timeout()
{
  display.clearDisplay();   
  display.drawRect(0, 0, 84 , 48,BLACK);
  display.setCursor(5,30);
  display.print("DHT error:");
  draw_error();
  display.display();
}
//****************************display title***********************//
void display_title()
{
  display.drawRect(0, 0, 84 , 48,BLACK);
  display.setCursor(4,8);
  display.print("Live Update");
  display.setCursor(4,20);
  display.print("Of Temp"); 
  display.setCursor(4,30);
  display.print("And Humidity");
  display.drawBitmap(70,37,logo_el,10,10,BLACK); 
  display.display();
  delay(5000);
  display.clearDisplay();
}
